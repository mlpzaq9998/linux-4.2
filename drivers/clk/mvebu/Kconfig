## drivers/clk/mvebu/Kconfig
```kconfig
config MVEBU_CLK_COMMON
	bool

config MVEBU_CLK_CPU
	bool

config MVEBU_CLK_COREDIV
	bool

config ARMADA_370_CLK
	bool
	select MVEBU_CLK_COMMON
	select MVEBU_CLK_CPU
	select MVEBU_CLK_COREDIV

config ARMADA_375_CLK
	bool
	select MVEBU_CLK_COMMON

config ARMADA_38X_CLK
	bool
	select MVEBU_CLK_COMMON

config ARMADA_39X_CLK
	bool
	select MVEBU_CLK_COMMON

config ARMADA_37XX_CLK
       bool

config ARMADA_XP_CLK
	bool
	select MVEBU_CLK_COMMON
	select MVEBU_CLK_CPU
	select MVEBU_CLK_COREDIV

config MSYS_CLK
	bool
	select MVEBU_CLK_COMMON
	select MVEBU_CLK_CPU
	select MVEBU_CLK_COREDIV

config ARMADA_3700_CLK
	bool
	default y
	depends on ARM_ARMADA3700_CPUFREQ

config ARMADA_CP110_SYSCON
	bool

config DOVE_CLK
	bool
	select MVEBU_CLK_COMMON

config KIRKWOOD_CLK
	bool
	select MVEBU_CLK_COMMON

config ORION_CLK
	bool
	select MVEBU_CLK_COMMON

config ARMADA_AP806_SYSCON
	bool
	default y
	depends on ARM_ARMADA_8K_CPUFREQ && MVEBU_CLK_COMMON

config ARMADA_AP806_CORE_CLK
	bool
	default y
	depends on ARM_ARMADA_8K_CPUFREQ && MVEBU_CLK_COMMON

config ARMADA_AP806_RING_CLK
	bool
	default y
	depends on ARM_ARMADA_8K_CPUFREQ && MVEBU_CLK_COMMON

config ARMADA_AP806_CPU_CLK
	bool
	default y
	depends on ARM_ARMADA_8K_CPUFREQ && MVEBU_CLK_COMMON

config ARMADA_37XX_PM_CLK
	bool
	default y
	select REGULATOR_ARMADA3700
	depends on ARM_ARMADA3700_CPUFREQ
```

## drivers/pinctrl/realtek/Kconfig
```kconfig
config PINCTRL_RTD129X
	bool "RTD129X pin controller driver"
	select PINMUX
	select GENERIC_PINCONF
	depends on ARCH_RTD129X
```

## drivers/powerctrl/Kconfig
```kconfig
menu "Power Control"
	depends on ARCH_RTD129X

config POWER_CONTROL
	bool "Power Control Support"
	depends on ARCH_RTD129X
	default y

config POWER_CONTROL_DEBUGFS
	bool "DebugFs fpr Power Control"
	depends on POWER_CONTROL && ARCH_RTD129X
	default n

config POWER_CONTROL_RTD129X
	bool "Power Control for RTD192x"
	depends on POWER_CONTROL && ARCH_RTD129X
	default y

config POWER_CONTROL_RTD129X_DEBUGFS
	bool "DebugFs for RTD192x Power Control"
	depends on POWER_CONTROL_RTD129X && ARCH_RTD129X
	default y
endmenu
```

## drivers/qnap/Kconfig
```kconfig
#
# QNAP NAS Driver
#

config QNAP_NASDRIVER
	bool

if QNAP_NASDRIVER

config QND_PATH
	string
	option env="QND_PATH"

source "$QND_PATH/Kconfig"

config QND_INTEL_LPC_WA
	bool "Intel Braswell/ApolloLake LPC workaround"
	depends on X86_64
	default n

config QND_RTC_RX8900_SUPPORT
        tristate "Support RTC RX8900"
        depends on X86_64 || X86
        default nk

endif
```

## drivers/soc/alpine/Kconfig
```kconfig
#
# Alpine SoC drivers configuration
#

menuconfig AL_TDM_TEST_MODULE
	tristate "AL TDM Test Module"
	depends on ARCH_ALPINE
    default n
	help
	  Alpine TDM Test Module
```

## drivers/soc/realtek/rtd129x/Kconfig
```kconfig
comment "RTD129X Device Drivers"

menu "RTD129X Device Drivers"

config RTK_SB2_MEM_TRASH_MONITOR
	bool "Memory trash monitor"
	default n
	help
	  Enable helper functions for memory trash detection. If unsure, say N.

config RTK_RBUS_BARRIER
	bool "R-bus barrier"
	depends on RTK_MEM_REMAP
	default y
	help
	  Enable helper functions for R-bus barrier. If unsure, say N.

config RTK_MEM_REMAP
	bool "Memory remap"
	default y
	help
	  Enable helper functions for static ioremap. If unsure, say N.

config RTK_FAN
	bool "RTK Fan driver"
	default n
	help
	  Realtek Fan driver

config RTK_SW_LOCK_API
	bool "RTK SW LOCK API"
	default y
	help
	  Realtek SW LOCK API driver

config RTK_SUSPEND
        bool "RTK support suspend function"
        help
          Realtek suspend driver

config RTK_ION
        bool "RTK support ION driver"
        help
          Realtek ION driver

source "drivers/soc/realtek/rtd129x/rtk_ve/Kconfig"
source "drivers/soc/realtek/rtd129x/irda/Kconfig"
source "drivers/soc/realtek/rtd129x/rpc/Kconfig"
source "drivers/soc/realtek/rtd129x/hw_nat/Kconfig"
endmenu #RTD129X Device Drivers
```

## drivers/switch/Kconfig
```kconfig
menuconfig SWITCH
	tristate "Switch class support"
	depends on ARCH_RTD129X
	help
	  Say Y here to enable switch class support. This allows
	  monitoring switches by userspace via sysfs and uevent.

if SWITCH && ARCH_RTD129X

config SWITCH_GPIO
	tristate "GPIO Swith support"
	depends on GPIOLIB
	help
	  Say Y here to enable GPIO based switch support.

endif # SWITCH
```

## drivers/target/iscsi/Kconfig
```kconfig
config ISCSI_TARGET
	tristate "Linux-iSCSI.org iSCSI Target Mode Stack"
	depends on NET
	select CRYPTO
	select CRYPTO_CRC32C
	select CRYPTO_CRC32C_INTEL if X86
	help
	Say M here to enable the ConfigFS enabled Linux-iSCSI.org iSCSI
	Target Mode Stack.

config ISCSI_ERROR_INJECTION
	tristate "QNAP_ISCSI ERROR_INJECTION"
	depends on ISCSI_TARGET
	help
	Say M here to enable QNAP ISCSI ERROR INJECTION feature

config ISCSI_CMD_OVSLT_CNT
	tristate "QNAP_ISCSI CMD_OVSLT_CNT"
	depends on ISCSI_TARGET
	help
	Say M here to enable QNAP ISCSI COMMAND OVERSALT COUNT feature
```

## drivers/thermal/realtek/Kconfig
```kconfig
config RTK_THERMAL
    tristate "Realtek thermal management"
    depends on OF && ARCH_RTD129X
    default y

config RTK_THERMAL_CPU_CORE_COOLING
    tristate "Realtek cpu_core cooling"
    depends on RTK_THERMAL && HOTPLUG_CPU 
    default y
```

## drivers/thunderbolt/Kconfig
```kconfig
config THUNDERBOLT
	tristate "Thunderbolt support"
	depends on PCI
	select CRC32
	help
	  Thunderbolt Controller driver

if THUNDERBOLT

config THUNDERBOLT_APPLE
	tristate "Apple hardware support"
	help
	  This driver is required if you want to hotplug Thunderbolt devices on
	  Apple hardware.

	  Device chaining is currently not supported.

	  To compile this driver as a module, choose M here. The module will be
	  called thunderbolt.

config THUNDERBOLT_ICM
	tristate "Thunderbolt Networking"
	help
	  This driver is required if you want Thunderbolt Networking on
	  non-Apple hardware.
	  It creates a virtual Ethernet device that enables computer to
	  computer communication over a Thunderbolt cable.

	  To compile this driver as a module, choose M here. The module will be
	  called thunderbolt_icm.

endif
```

## sound_intel/Kconfig
```kconfig
menuconfig SOUND_INTEL
	tristate "Sound card support(newer)"
	depends on (HAS_IOMEM && SOUND=n)
	help
	  If you have a sound card in your computer, i.e. if it can say more
	  than an occasional beep, say Y.  Be sure to have all the information
	  about your sound card and its configuration down (I/O port,
	  interrupt and DMA channel), because you will be asked for it.

	  You want to read the Sound-HOWTO, available from
	  <http://www.tldp.org/docs.html#howto>. General information about
	  the modular sound system is contained in the files
	  <file:Documentation/sound/oss/Introduction>.  The file
	  <file:Documentation/sound/oss/README.OSS> contains some slightly
	  outdated but still useful information as well.  Newer sound
	  driver documentation is found in <file:Documentation/sound/alsa/*>.

	  If you have a PnP sound card and you want to configure it at boot
	  time using the ISA PnP tools (read
	  <http://www.roestock.demon.co.uk/isapnptools/>), then you need to
	  compile the sound card support as a module and load that module
	  after the PnP configuration is finished.  To do this, choose M here
	  and read <file:Documentation/sound/oss/README.modules>; the module
	  will be called soundcore.

if SOUND_INTEL

config SOUND_OSS_CORE
	bool
	default n

config SOUND_OSS_CORE_PRECLAIM
	bool "Preclaim OSS device numbers"
	depends on SOUND_OSS_CORE
	default y
	help
	  With this option enabled, the kernel will claim all OSS device
	  numbers if any OSS support (native or emulation) is enabled
	  whether the respective module is loaded or not and try to load the
	  appropriate module using sound-slot/service-* and char-major-*
	  module aliases when one of the device numbers is opened.  With
	  this option disabled, kernel will only claim actually in-use
	  device numbers and opening a missing device will generate only the
	  standard char-major-* aliases.

	  The only visible difference is use of additional module aliases
	  and whether OSS sound devices appear multiple times in
	  /proc/devices.  sound-slot/service-* module aliases are scheduled
	  to be removed (ie. PRECLAIM won't be available) and this option is
	  to make the transition easier.  This option can be overridden
	  during boot using the kernel parameter soundcore.preclaim_oss.

	  Disabling this allows alternative OSS implementations.

	  If unsure, say Y.

source "sound_intel/oss/dmasound/Kconfig"

if !M68K && !UML

menuconfig SND
	tristate "Advanced Linux Sound Architecture"
	help
	  Say 'Y' or 'M' to enable ALSA (Advanced Linux Sound Architecture),
	  the new base sound system.

	  For more information, see <http://www.alsa-project.org/>

if SND

source "sound_intel/core/Kconfig"

source "sound_intel/drivers/Kconfig"

source "sound_intel/isa/Kconfig"

source "sound_intel/pci/Kconfig"

source "sound_intel/hda/Kconfig"

source "sound_intel/ppc/Kconfig"

source "sound_intel/aoa/Kconfig"

source "sound_intel/arm/Kconfig"

source "sound_intel/atmel/Kconfig"

source "sound_intel/spi/Kconfig"

source "sound_intel/mips/Kconfig"

source "sound_intel/sh/Kconfig"

# the following will depend on the order of config.
# here assuming USB is defined before ALSA
source "sound_intel/usb/Kconfig"

source "sound_intel/firewire/Kconfig"

# the following will depend on the order of config.
# here assuming PCMCIA is defined before ALSA
source "sound_intel/pcmcia/Kconfig"

source "sound_intel/sparc/Kconfig"

source "sound_intel/parisc/Kconfig"

source "sound_intel/soc/Kconfig"

endif # SND

menuconfig SOUND_PRIME
	tristate "Open Sound System (DEPRECATED)"
	select SOUND_OSS_CORE
	help
	  Say 'Y' or 'M' to enable Open Sound System drivers.

if SOUND_PRIME

source "sound_intel/oss/Kconfig"

endif # SOUND_PRIME

endif # !M68K

endif # SOUND_INTEL

# AC97_BUS is used from both sound and ucb1400
config AC97_BUS
	tristate
	help
	  This is used to avoid config and link hard dependencies between the
	  sound subsystem and other function drivers completely unrelated to
	  sound although they're sharing the AC97 bus. Concerned drivers
	  should "select" this.
```

## sound_intel/soc/Kconfig
```kconfig
#
# SoC audio configuration
#

menuconfig SND_SOC
	tristate "ALSA for SoC audio support"
	select SND_PCM
	select AC97_BUS if SND_SOC_AC97_BUS
	select SND_JACK
	select REGMAP_I2C if I2C
	select REGMAP_SPI if SPI_MASTER
	---help---

	  If you want ASoC support, you should say Y here and also to the
	  specific driver for your SoC platform below.
	  
	  ASoC provides power efficient ALSA support for embedded battery powered
	  SoC based systems like PDA's, Phones and Personal Media Players.

	  This ASoC audio support can also be built as a module.  If so, the module
	  will be called snd-soc-core.

if SND_SOC

config SND_SOC_AC97_BUS
	bool

config SND_SOC_GENERIC_DMAENGINE_PCM
	bool
	select SND_DMAENGINE_PCM

config SND_SOC_COMPRESS
	bool
	select SND_COMPRESS_OFFLOAD

config SND_SOC_TOPOLOGY
	bool

# All the supported SoCs
source "sound_intel/soc/adi/Kconfig"
source "sound_intel/soc/amd/Kconfig"
source "sound_intel/soc/atmel/Kconfig"
source "sound_intel/soc/au1x/Kconfig"
source "sound_intel/soc/bcm/Kconfig"
source "sound_intel/soc/blackfin/Kconfig"
source "sound_intel/soc/cirrus/Kconfig"
source "sound_intel/soc/davinci/Kconfig"
source "sound_intel/soc/dwc/Kconfig"
source "sound_intel/soc/fsl/Kconfig"
source "sound_intel/soc/jz4740/Kconfig"
source "sound_intel/soc/nuc900/Kconfig"
source "sound_intel/soc/omap/Kconfig"
source "sound_intel/soc/kirkwood/Kconfig"
source "sound_intel/soc/img/Kconfig"
source "sound_intel/soc/intel/Kconfig"
source "sound_intel/soc/mediatek/Kconfig"
source "sound_intel/soc/mxs/Kconfig"
source "sound_intel/soc/pxa/Kconfig"
source "sound_intel/soc/qcom/Kconfig"
source "sound_intel/soc/rockchip/Kconfig"
source "sound_intel/soc/samsung/Kconfig"
source "sound_intel/soc/sh/Kconfig"
source "sound_intel/soc/sirf/Kconfig"
source "sound_intel/soc/spear/Kconfig"
source "sound_intel/soc/sti/Kconfig"
source "sound_intel/soc/sunxi/Kconfig"
source "sound_intel/soc/tegra/Kconfig"
source "sound_intel/soc/txx9/Kconfig"
source "sound_intel/soc/ux500/Kconfig"
source "sound_intel/soc/xtensa/Kconfig"
source "sound_intel/soc/zte/Kconfig"

# Supported codecs
source "sound_intel/soc/codecs/Kconfig"

# generic frame-work
source "sound_intel/soc/generic/Kconfig"

endif	# SND_SOC
```
